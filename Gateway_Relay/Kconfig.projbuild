## Gateway_Relay/Kconfig.projbuild
```kconfig
menu "Gateway Relay Configuration"

config CAN_UPLINK
    bool "Enable uplink capabilities"
    default y
    help
        When enabled, device can act as mesh root and perform cloud uplink.

config RAW_QUEUE_LEN
    int "Raw RX queue length"
    default 64
    range 8 256
    help
        Queue for raw mesh frames before decoding. Tune based on traffic burstiness.

config DECODED_QUEUE_LEN
    int "Decoded queue length"
    default 64
    range 8 256
    help
        Queue after decoding/validation before spooling.

config STORAGE_QUEUE_LEN
    int "Storage queue length"
    default 64
    range 8 256
    help
        Queue for records waiting to be appended to the durable spool.

config SPOOL_PARTITION_LABEL
    string "LittleFS partition label"
    default "spool"
    help
        Partition label used for durable spool storage.

config SPOOL_MAX_BYTES
    int "Max spool size (bytes)"
    default 2097152
    help
        Size threshold for spool rotation.

config CLOUD_BATCH_MAX_RECORDS
    int "Cloud batch max records"
    default 32
    help
        Maximum records sent per HTTP request.

config CLOUD_BATCH_TIME_SEC
    int "Cloud batch time window (sec)"
    default 15
    help
        Time window for batching outgoing records.

endmenu
```

## Node/main/Kconfig.projbuild
```kconfig
menu "Mesh Configuration"

    config ESP_MESH_MAX_LAYER
        int "Max Mesh Layer"
        range 1 10
        default 3
        help
            Maximum number of mesh layers.

    config ESP_MESH_CHANNEL
        int "Mesh Channel (FIXED)"
        range 1 13
        default 6
        help
            Fixed channel for ESP-MESH.
            All nodes MUST use the same channel.

    config ESP_WIFI_SSID
        string "Router SSID"
        default "CEEC_Tenda"
        help
            Router SSID (used by ROOT only).

    config ESP_WIFI_PASSWORD
        string "Router Password"
        default "1denmuoi1"
        help
            Router password (used by ROOT only).

    config ESP_GTK_REKEYING_ENABLE
        bool "Enable GTK Rekeying"
        default y

    config ESP_GTK_REKEY_INTERVAL
        int "GTK Rekey Interval (s)"
        depends on ESP_GTK_REKEYING_ENABLE
        range 60 65535
        default 600

endmenu
```
